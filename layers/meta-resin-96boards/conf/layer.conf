## layers/meta-resin-96boards/conf/layer.conf
```bitbake
BBPATH .= ":${LAYERDIR}"

BBFILES += "${LAYERDIR}/recipes-*/*/*.bb \
            ${LAYERDIR}/recipes-*/*/*.bbappend"

BBFILE_COLLECTIONS += "resin-96boards"
BBFILE_PATTERN_resin-96boards := "^${LAYERDIR}/"
BBFILE_PRIORITY_resin-96boards = "1337"
```
